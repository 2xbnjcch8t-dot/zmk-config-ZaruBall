#include "ZaruBall.dtsi"

&kscan0 {
    gpios
        = <&xiao_d 0 GPIO_ACTIVE_HIGH>//M1
        , <&xiao_d 1 GPIO_ACTIVE_HIGH>//M2
        , <&xiao_d 2 GPIO_ACTIVE_HIGH>//M3
        , <&xiao_d 3 GPIO_ACTIVE_HIGH>//M4
        , <&xiao_d 4 GPIO_ACTIVE_HIGH>//M5
        , <&xiao_d 5 GPIO_ACTIVE_HIGH>//M6
        , <&xiao_d 6 GPIO_ACTIVE_HIGH>//M7


        // ▼ここを“D8/D9を使わない”ように変更
        , <&gpio1 10 GPIO_ACTIVE_HIGH> // T1  ← 旧: xiao_d 9
        , <&gpio0 16 GPIO_ACTIVE_HIGH> // T2  ← 旧: xiao_d 8
        , <&xiao_d 7  GPIO_ACTIVE_HIGH> // T3（据え置き or 必要なら入替可）
        ;
    interrupt-gpios = <&xiao_d 10 (GPIO_ACTIVE_HIGH | GPIO_PULL_DOWN)>;//IGPIO
};

&left_encoder {
    compatible = "alps,ec11";
    // キーマトリクスで使わなくなった D8/D9 を割り当て
    a-gpios = <&xiao_d 8 (GPIO_ACTIVE_HIGH | GPIO_PULL_UP)>;
    b-gpios = <&xiao_d 9 (GPIO_ACTIVE_HIGH | GPIO_PULL_UP)>;

    // Zephyrの一般的なプロパティ名は "resolution"
    resolution = <4>;   // 1ノッチのパルス数。2〜4で好み調整
    status = "okay";
};

